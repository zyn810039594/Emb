#include <Servo.h>
#define u8 unsigned char
char Rev2;
char Receive[70];
char Rev2Start = 0;
char Pos2 = 0;
char MoveMode = 0;
char SendLetter[8]="0:0:00";
int XNum = 100;
int YNum = 100;
u8 LFMode = 0;
static unsigned char EleNum[202][2] = {{0xf4, 0x01}, {0xfe, 0x01}, {0x08, 0x02}, {0x12, 0x02}, {0x1c, 0x02},
  {0x26, 0x02}, {0x30, 0x02}, {0x3a, 0x02}, {0x44, 0x02}, {0x4e, 0x02}, {0x58, 0x02}, {0x62, 0x02}, {0x6c, 0x02},
  {0x76, 0x02}, {0x80, 0x02}, {0x8a, 0x02}, {0x94, 0x02}, {0x9e, 0x02}, {0xa8, 0x02}, {0xb2, 0x02}, {0xbc, 0x02}, {0xc6, 0x02},
  {0xd0, 0x02}, {0xda, 0x02}, {0xe4, 0x02}, {0xee, 0x02}, {0xf8, 0x02}, {0x02, 0x03}, {0x0c, 0x03}, {0x16, 0x03},
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  {0x6a, 0x09}, {0x74, 0x09}, {0x7e, 0x09}, {0x88, 0x09}, {0x92, 0x09}, {0x9c, 0x09}, {0xa6, 0x09}, {0xb0, 0x09}, {0xba, 0x09}, {0xc4, 0x09}
};
static unsigned char MovNum[202][2] = {{0xbc, 0x02}, {0xc4, 0x02}, {0xcc, 0x02}, {0xd4, 0x02}, {0xdc, 0x02}, {0xe4, 0x02}, {0xec, 0x02}, {0xf4, 0x02}, {0xfc, 0x02}, {0x04, 0x03},
  {0x0c, 0x03}, {0x14, 0x03}, {0x1c, 0x03}, {0x24, 0x03}, {0x2c, 0x03}, {0x34, 0x03}, {0x3c, 0x03}, {0x44, 0x03}, {0x4c, 0x03}, {0x54, 0x03},
  {0x5c, 0x03}, {0x64, 0x03}, {0x6c, 0x03}, {0x74, 0x03}, {0x7c, 0x03}, {0x84, 0x03}, {0x8c, 0x03}, {0x94, 0x03}, {0x9c, 0x03}, {0xa4, 0x03},
  {0xac, 0x03}, {0xb4, 0x03}, {0xbc, 0x03}, {0xc4, 0x03}, {0xcc, 0x03}, {0xd4, 0x03}, {0xdc, 0x03}, {0xe4, 0x03}, {0xec, 0x03}, {0xf4, 0x03},
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  {0xfc, 0x08}
};
static unsigned char LFNum[2][2] = {{0x4c, 0x04}, {0x6c, 0x07}};
unsigned char DM0_Speed20_Position_0[15]    =    { 0xff, 0x01, 0x00, 0x14, 0x00, 0xff, 0x02, 0x00, 0xf4, 0x01 };
unsigned char port[16] = {0x00, 0x01, 0x02, 0x03, 0x04, 0x05, 0x06, 0x07, 0x08, 0x09, 0x0a, 0x0b, 0x0c, 0x0d, 0x0e, 0x0f};
Servo myservo1;
Servo myservo2;
Servo myservo3;
int ChangeNum = 0;
u8 MovPort;
int a0, a1, a2;
float Water1Num, Water2Num, result;
u8 TemOut, Water1Out, Water2Out;

void EleChange(int change, unsigned char portnum)
{
  u8 EleSend[10] = {DM0_Speed20_Position_0[0], DM0_Speed20_Position_0[1], port[portnum], DM0_Speed20_Position_0[3], DM0_Speed20_Position_0[4], DM0_Speed20_Position_0[5], DM0_Speed20_Position_0[6], port[portnum], EleNum[change][0], EleNum[change][1]};
  Serial2.write(EleSend, 10);
}

void MovChange(int change, unsigned char portnum)
{
  u8 MovSend[10] = {DM0_Speed20_Position_0[0], DM0_Speed20_Position_0[1], port[portnum], DM0_Speed20_Position_0[3], DM0_Speed20_Position_0[4], DM0_Speed20_Position_0[5], DM0_Speed20_Position_0[6], port[portnum], MovNum[change][0], MovNum[change][1]};
  Serial2.write(MovSend, 10);
}

void LFChange(u8 changeflag)
{
  u8 LFSend[10] = {DM0_Speed20_Position_0[0], DM0_Speed20_Position_0[1], port[12], DM0_Speed20_Position_0[3], DM0_Speed20_Position_0[4], DM0_Speed20_Position_0[5], DM0_Speed20_Position_0[6], port[12], LFNum[changeflag][0], LFNum[changeflag][1]};
  Serial2.write(LFSend, 10);
}

void MovInit(void)
{
  MovChange(100, port[0]);
  delay(100);
  MovChange(100, port[1]);
  delay(100);
  MovChange(100, port[2]);
  delay(100);
  MovChange(100, port[13]);
  delay(100);
  MovChange(100, port[14]);
  delay(100);
  MovChange(100, port[15]);

}

void setup()
{
  // put your setup code here, to run once:
  delay(8000);
  Serial3.begin(9600);
  Serial2.begin(9600);
  pinMode(9, OUTPUT);
  //  pinMode(10,OUTPUT);
  //  pinMode(11,OUTPUT);
  myservo1.attach(10);
  myservo2.attach(11);
  myservo3.attach(8);
  MovInit();
  EleChange(0,11);
}

void loop()
{
  // put your main code here, to run repeatedly:
  if (Serial3.available())
  {
    Rev2 = Serial3.read();
    if (Rev2 == '$')
    {
      Rev2Start = 1;
    }
    if (Rev2Start == 1)
    {
      Receive[Pos2] = Rev2;
      ++Pos2;
      if (Rev2 == '%')
      {
        if (Pos2 == 67)
        {
          MoveMode = (Receive[1] - '0');
          XNum = (Receive[3] - '0') * 100 + (Receive[4] - '0') * 10 + (Receive[5] - '0');
          YNum = (Receive[7] - '0') * 100 + (Receive[8] - '0') * 10 + (Receive[9] - '0');
          switch (MoveMode)
          {
            case 1:
              MovChange(XNum, 1);
              MovChange(XNum, 2);
              MovChange((100 - XNum + YNum), 13);
              MovChange((100 - XNum + YNum), 14);
              break;
            case 2:
              MovChange(YNum, 1);
              MovChange(YNum, 2);
              MovChange((100 - XNum + YNum), 13);
              MovChange((100 - XNum + YNum), 14);
              break;
            case 3:
              MovChange((XNum + YNum - 100), 1);
              MovChange((XNum + YNum - 100), 2);
              MovChange(YNum, 13);
              MovChange(YNum, 14);
              break;
            case 4:
              MovChange((XNum + YNum - 100), 1);
              MovChange((XNum + YNum - 100), 2);
              MovChange((200 - XNum), 13);
              MovChange((200 - XNum), 14);
              break;
            case 5:
              MovChange(XNum, 1);
              MovChange((200 - XNum), 2);
              MovChange((200 - XNum), 13);
              MovChange(XNum, 14);
              break;
          }
          ChangeNum = (Receive[11] - '0') * 100 + (Receive[12] - '0') * 10 + (Receive[13] - '0');
          MovChange(ChangeNum, 0);
          MovChange(ChangeNum, 15);
          ChangeNum = (Receive[15] - '0') * 100 + (Receive[16] - '0') * 10 + (Receive[17] - '0');
          EleChange(ChangeNum, 11);
          digitalWrite(9, Receive[19] - '0');
          ChangeNum = (Receive[21] - '0') * 100 + (Receive[22] - '0') * 10 + (Receive[23] - '0');
          ChangeNum = map(ChangeNum, 0, 200, 1100, 1900);
          myservo3.writeMicroseconds(ChangeNum);
          ChangeNum = (Receive[25] - '0') * 100 + (Receive[26] - '0') * 10 + (Receive[27] - '0');
          EleChange(ChangeNum, 3);
          ChangeNum = (Receive[29] - '0') * 100 + (Receive[30] - '0') * 10 + (Receive[31] - '0');
          EleChange(ChangeNum, 4);
          ChangeNum = (Receive[33] - '0') * 100 + (Receive[34] - '0') * 10 + (Receive[35] - '0');
          EleChange(ChangeNum, 5);
          ChangeNum = (Receive[37] - '0') * 100 + (Receive[38] - '0') * 10 + (Receive[39] - '0');
          EleChange(ChangeNum, 6);
          ChangeNum = (Receive[41] - '0') * 100 + (Receive[42] - '0') * 10 + (Receive[43] - '0');
          ChangeNum = map(ChangeNum, 0, 200, 1100, 1900);
          myservo1.writeMicroseconds(ChangeNum);
          ChangeNum = (Receive[45] - '0') * 100 + (Receive[46] - '0') * 10 + (Receive[47] - '0');
          EleChange(ChangeNum, 7);
          ChangeNum = (Receive[49] - '0') * 100 + (Receive[50] - '0') * 10 + (Receive[51] - '0');
          EleChange(ChangeNum, 8);
          ChangeNum = (Receive[53] - '0') * 100 + (Receive[54] - '0') * 10 + (Receive[55] - '0');
          EleChange(ChangeNum, 9);
          ChangeNum = (Receive[57] - '0') * 100 + (Receive[58] - '0') * 10 + (Receive[59] - '0');
          EleChange(ChangeNum, 10);
          ChangeNum = (Receive[61] - '0') * 100 + (Receive[62] - '0') * 10 + (Receive[63] - '0');
          ChangeNum = map(ChangeNum, 0, 200, 1100, 1900);
          myservo2.writeMicroseconds(ChangeNum);
          LFMode = (Receive[65] - '0');
          LFChange(LFMode);


        }
        Rev2Start = 0;
        Pos2 = 0;
      }

    }
  }
  a0 = analogRead(A0);
  a1 = analogRead(A1);
  a2 = analogRead(A2);
  result = (float)a0 * (5 / 1024.0) * 100;
  Water1Num = (float)a1 * (5 / 1024.0);
  Water2Num = (float)a2 * (5 / 1024.0);
  u8 TemOut = (u8)result;
  if (Water1Num >= 2.5)
  {
    Water1Out = 1;
  }
  else if (Water2Num >= 2.5)
  {
    Water2Out = 1;
  }
  SendLetter[0]=(Water1Out+'0');
  SendLetter[2]=(Water2Out+'0');
  Water1Out=0;
  Water2Out=0;
  SendLetter[5]=(TemOut/10+'0');
  SendLetter[6]=(TemOut%10+'0');
  Serial3.print(SendLetter);

}
